/*
 * Copyright (c) 2025 Vincent Franco
 * SPDX-License-Identifier: MIT
 */

#include "crosses.dtsi"
#include "input_processors.dtsi"
#include <zephyr/dt-bindings/input/input-event-codes.h>

&kscan0 {
	col-gpios
		= <&gpio0 8 (GPIO_ACTIVE_HIGH | GPIO_PULL_DOWN)>
		, <&gpio1 15 (GPIO_ACTIVE_HIGH | GPIO_PULL_DOWN)>
		, <&gpio1 13 (GPIO_ACTIVE_HIGH | GPIO_PULL_DOWN)>
		, <&gpio0 9 (GPIO_ACTIVE_HIGH | GPIO_PULL_DOWN)>
		, <&gpio0 10  (GPIO_ACTIVE_HIGH | GPIO_PULL_DOWN)>
		, <&gpio1 11 (GPIO_ACTIVE_HIGH | GPIO_PULL_DOWN)>
		;
};

&spi1 {
  status = "disabled";
};

// No trackball hardware on the left half
&trackball_peripheral_split {
  status = "disabled";
};

&pro_micro_i2c {
    status = "disabled";
};
